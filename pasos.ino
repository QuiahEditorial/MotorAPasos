// Por Roberto A.Zavala
// 🙏🏼 DogeCoin : DNv7acPAeVBhTXbKv26itJecPG1SPy2o4F
// Breve : https://es.overleaf.com/read/ypbswnmywdcn
// Libro : https://www.amazon.com.mx/dp/B074TTGLL2
// https://docs.google.com/spreadsheets/d/1v66FqD7zOg-H4kmhq8ojUr9T9_6hwO1IgihTE_KEoy4/edit?usp=sharing

int A = 3;              // puertos PWM                         
int B = 6;
int C = 9;
int D = 10;

int  j;                 // Contadores
int  i;

int paso [4][4]=        // matriz de estados paso simple
{
{1,0,0,0},
{0,1,0,0},
{0,0,1,0},            
{0,0,0,1},
};

int mpas [8][4]=        // matriz de estados medio paso
{
{1,0,0,0},
{1,1,0,0},
{0,1,0,0},            
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{1,0,0,1}
};

int tpas [8][4]=        // matriz de estados alto torque
{
{1,1,0,0},
{0,1,1,0},
{0,0,1,1},
{1,0,0,1}
};

int suav [145][4]=      // matriz de estados paso suave Arduino ignora el decimal
{
{ 255.0 , 0.0 , 0.0 , 0 } ,
{ 254.8 , 11.1  , 0.0 , 0 } ,
{ 254.0 , 22.2  , 0.0 , 0 } ,
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{ 255.0 , 0.0 , 0.0 , 0.0 } 
};

int vect[31]=           // Matriz de estado simplificada paso suave
{
 255 ,
 255 ,
 254 ,
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 13  ,
 0
};

int P[4][2] = { {D , A },   // Puertos PWM
                {A , B },
                {B , C },
                {C , D } };

void setup()
{
Serial.begin(9600);
pinMode(A,OUTPUT);
pinMode(B,OUTPUT);
pinMode(C,OUTPUT);
pinMode(D,OUTPUT);
}

void loop()
{
Paso(); delay(1000);
mPas(); delay(1000);
tPas(); delay(1000);
Suav(); delay(1000);
Vect(); delay(1000);
}

void Paso()
{
for (int i=0; i<=3; i++)           // Un ciclo de paso simple
    {
    digitalWrite(A, paso[i][0]);
    digitalWrite(B, paso[i][1]);
    digitalWrite(C, paso[i][2]);
    digitalWrite(D, paso[i][3]);
    delay(500);
    }
}

void mPas()
{
 for (int i=0; i<=7; i++)           // Un ciclo de medio paso
    {
    digitalWrite(A, mpas[i][0]);
    digitalWrite(B, mpas[i][1]);
    digitalWrite(C, mpas[i][2]);
    digitalWrite(D, mpas[i][3]);
    delay(500);
    }
}

void tPas()
{
for (int i=0; i<=3; i++)           // Un ciclo de alto torque
    {
    digitalWrite(A, tpas[i][0]);
    digitalWrite(B, tpas[i][1]);
    digitalWrite(C, tpas[i][2]);
    digitalWrite(D, tpas[i][3]);
    delay(500);
    }
}

void Suav()
{
for (int i=0; i<=67; i++)           // Un ciclo de paso suave
    {
    analogWrite(A, suav[i][0]);
    analogWrite(B, suav[i][1]);
    analogWrite(C, suav[i][2]);
    analogWrite(D, suav[i][3]);
    delay(50);
    }
}

void Vect()                         // Un cliclo de paso suave
{
for ( i=0; i<=3; i++)
{
  for ( j=0; j<=30; j++ )
  {
  analogWrite(P[i][0], Suave[30-j]);
  analogWrite(P[i][1], Suave[j]);
  delay(500);
  }
}
}
